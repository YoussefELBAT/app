## CMakeLists.txt
```
#
# Copyright (c) 2017 Linaro Limited
#
# SPDX-License-Identifier: Apache-2.0
#

cmake_minimum_required(VERSION 3.20.0)
find_package(Zephyr REQUIRED HINTS $ENV{ZEPHYR_BASE})
project(nrf_connect_sdk_fundamentals)

target_sources(app PRIVATE src/main.c)
target_sources_ifdef(CONFIG_LIBRARY app PRIVATE src/library.c)
```

## Kconfig
```
source "Kconfig.zephyr"
config LIBRARY
	bool "Enable my function"
	default n
```

## sample.yaml
```
sample:
  description: Sycon Application
  name: SY APP
common:
  platform_allow: > 
    - thingy53_nrf5340_cpuapp
    - thingy53_nrf5340_cpuapp_ns
  tags: sycon
```

## west.yml
```
# Example T2 west.yml, using manifest imports.
manifest:
  remotes:
    - name: zephyrproject-rtos
      url-base: https://github.com/zephyrproject-rtos
  projects:
    - name: zephyr
      remote: zephyrproject-rtos
      revision: v3.5.0
      import:
        name-allowlist:
          - cmsis
          - hal_nordic
          - openthread

  self:
    path: app
```

## prj.conf
```kconfig
#
# Copyright (c) 2017 Linaro Limited
#
# SPDX-License-Identifier: Apache-2.0
#
# Enable the printk 
CONFIG_PRINTK=y

# Enable the GPIO 
CONFIG_GPIO=y

# Enable the serial driver in asynchronous mode

CONFIG_SERIAL=y
CONFIG_UART_ASYNC_API=y


#Enable Timeslicing parameters

CONFIG_TIMESLICING=y
CONFIG_TIMESLICE_SIZE=10
CONFIG_TIMESLICE_PRIORITY=4

# Enable the I2C driver
CONFIG_I2C=y

# Enable floating point format specifiers
CONFIG_CBPRINTF_FP_SUPPORT=y

CONFIG_MULTITHREADING=y
```

## src/main.c
```c
/*
 * Copyright (c) 2023 Sycon 
 *
 * SPDX-License-Identifier: Apache-2.0
 */



/*    
*  This file is used to define the threads, their priority and their parameters
*
*
*/

/* Zone of inclusion of default libraries */

#include <zephyr/kernel.h>
#include <zephyr/sys/printk.h>
#include <string.h>


/* ZONE OF inclusion of our libraries */

#ifdef CONFIG_LIBRARY
#include "library.h"
#endif


/*  ZONE OF DEFINITION OF STACKSIZE  */


/*  ZONE OF DEFINITION OF PRIORITIES  */




#define SLEEP_TIME_MS  1000



void main(void)
{
while(1){


    printk("____________________SALEM et Youssef _______________________\n\r");



}
  

     k_msleep(SLEEP_TIME_MS); 
}
```

## src/library.c
```c
/*
 * Copyright (c) 2023 Sycon 
 *
*/


#include "library.h"



/* Definition of the temperature function */





/* Definition of the Pression function */





/* Definition of the Humidity function */


 


/* Definition of the Gaz/air quality function */






/* Definition of the function Debug */





/* IF ever : Definition of the function Timestamp */
```

## src/library.h
```c
/*
 * Copyright (c) 2023 Sycon 
 *
*/
#ifndef _INCLUDE_LIBRARY_H
#define _INCLUDE_LIBRARY_H



/* Declaration of the temperature function */





/* Declaration of the Pression function */





/* Declaration of the Humidity function */


 


/* Declaration of the Gaz/air quality function */






/* Declaration of the function Debug */





/* IF ever : Declaration of the function LED */





/* IF ever : Declaration of the function Timestamp */







#endif
```
